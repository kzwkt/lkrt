## lib/Kconfig
```kconfig
menuconfig EXPLOIT
	bool "Enable the exploit library"
	default y
	help
	  Say Y if you want to enable the exploit library.
	  If you say N here, the exploits are not compiled.

if EXPLOIT

menu "Devices"

comment "Directory structure coincides with android device tree"

# See: https://android.googlesource.com/device

menuconfig DEVICE_GENERIC
	bool "Enable generic device"
	default y

if DEVICE_GENERIC

menuconfig DEVICE_GENERIC_COMMON
	bool "Enable generic device common"
	default y

if DEVICE_GENERIC_COMMON

config DIRTY_COW
	bool "Dirty COW (CVE-2016-5195)"
	default n
	help
	  Say Y if you want to enable the dirty cow exploit.

config ROOT_HELPER
	bool "roothelper"
	default n
	help
	  Say Y if you want to enable the roothelper exploit.

endif # DEVICE_GENERIC_COMMON

endif # DEVICE_GENERIC

endmenu

endif # EXPLOIT
```

## lib/device/Kconfig
```kconfig
menu "Devices"

comment "Directory structure coincides with android device tree"

# See: https://android.googlesource.com/device

source "lib/device/generic/Kconfig"

endmenu
```

## lib/device/generic/Kconfig
```kconfig
menuconfig DEVICE_GENERIC
	bool "Enable generic device"
	default y

if DEVICE_GENERIC

source "lib/device/generic/common/Kconfig"

endif # DEVICE_GENERIC
```

## lib/device/generic/common/Kconfig
```kconfig
menuconfig DEVICE_GENERIC_COMMON
	bool "Enable generic device common"
	default y

if DEVICE_GENERIC_COMMON

config DIRTY_COW
	bool "Dirty COW (CVE-2016-5195)"
	default n
	help
	  Say Y if you want to enable the dirty cow exploit.

config ROOT_HELPER
	bool "roothelper"
	default n
	help
	  Say Y if you want to enable the roothelper exploit.

endif # DEVICE_GENERIC_COMMON
```

## src/Kconfig
```kconfig
config ENABLE_CLI
	bool "Enable Command-line Interface"
	default y
	help
	  Say Y if you want to enable the command-line interface.
```
